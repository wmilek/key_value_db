## dts/bindings/fs/kvdb,fstab,blobfs.yaml
```yaml
# Copyright (c) 2026
# SPDX-License-Identifier: Apache-2.0

description: |
  A blobfs mount (CONFIG_BLOBFS_FS_INTEROP), as a child of a "zephyr,fstab"
  node -- the same shape as "zephyr,fstab,littlefs":

    fstab {
            compatible = "zephyr,fstab";
            blobfs0: blobfs {
                    compatible = "kvdb,fstab,blobfs";
                    mount-point = "/blob";
                    db = <&blobdb0>;
                    automount;
            };
    };

  The driver defines a struct fs_mount_t for the node, reachable as
  FS_FSTAB_ENTRY(node_id) after FS_FSTAB_DECLARE_ENTRY(node_id), and mounts it
  during boot when "automount" is set. blobfs supports one mount at a time,
  so at most one node of this compatible. "disk-access" is not supported.

compatible: "kvdb,fstab,blobfs"

include: "zephyr,fstab-common.yaml"

properties:
  db:
    type: phandle
    required: true
    description: The "kvdb,blob-db" store the file system lives in.
```

## dts/bindings/mtd/kvdb,ubi.yaml
```yaml
# Copyright (c) 2026
# SPDX-License-Identifier: Apache-2.0

description: |
  A fixed flash partition formatted as a UBI device (zephyr-ubi).

  The node is an ordinary child of a "fixed-partitions" node -- it keeps its
  partition id and flash_map entry -- with this compatible added. Its UBI
  volumes are described under a "volumes" child, one node per volume, in the
  shape of Linux's "linux,ubi" binding:

    ubi0: partition@0 {
            compatible = "kvdb,ubi";
            label = "storage";
            reg = <0x00000000 0x00800000>;
            spare-lebs = <4>;

            volumes {
                    blobdb_vol: ubi-volume-blobdb {
                            volname = "blobdb";
                    };
            };
    };

  On boards whose partitions are "zephyr,mapped-partition" nodes rather than
  fixed-partitions children (native_sim, for one), keep that compatible
  second -- it is what makes the node a partition:

    compatible = "kvdb,ubi", "zephyr,mapped-partition";

  A consumer points at a volume node with a phandle (for blob_db, the
  "storage" property of a "kvdb,blob-db" node). The consumer attaches the
  device and creates its volume on first use; volumes nothing points at are
  only documentation.

compatible: "kvdb,ubi"

include: base.yaml

properties:
  reg:
    required: true
    description: |
      <OFFSET SIZE> of the partition, relative to the parent flash memory,
      exactly as for any fixed-partitions child.

  label:
    type: string
    description: Human readable name of the partition.

  read-only:
    type: boolean
    description: Set if the partition is read-only.

  spare-lebs:
    type: int
    default: 4
    description: |
      LEBs left out of a volume that takes "the rest of the device" (one
      without a "size"). They give UBI's relocation a block to move onto and
      absorb blocks retired after a failed write, so neither turns into
      -ENOSPC once every LEB of the volume is mapped.

child-binding:
  description: |
    The "volumes" container. Holds one child node per UBI volume.

  child-binding:
    description: One UBI volume.

    properties:
      volname:
        type: string
        required: true
        description: |
          Volume name, unique within the device (at most
          UBI_VOLUME_NAME_MAX_LEN characters). The consumer finds the volume
          by this name and creates it when it is not there.

      size:
        type: int
        description: |
          Volume size in bytes, rounded up to whole LEBs when the volume is
          created. Absent means the rest of the device, less "spare-lebs".
          A volume's size is fixed at creation; changing it here does not
          resize an existing volume.
```

## dts/bindings/storage/kvdb,blob-db.yaml
```yaml
# Copyright (c) 2026
# SPDX-License-Identifier: Apache-2.0

description: |
  A blob_db store (lib/blob_db).

  "storage" says where the store lives. Pointing it at a UBI volume (a
  "volumes" child of a "kvdb,ubi" partition) selects the UBI backend by
  default; pointing it at a plain fixed partition selects the raw flash_area
  backend. CONFIG_BLOB_DB_BACKEND_* can still override the default: the
  flash_area backend over a UBI volume uses the partition under it raw, and
  the UBI backend over a plain partition creates a volume named "blobdb".

  blob_db is a single store: at most one node of this compatible, and the
  chosen node "kvdb,blob-db" must point at it (Kconfig finds the store's
  partition through it):

    chosen {
            kvdb,blob-db = &blobdb0;
    };

    blobdb0: blob-db {
            compatible = "kvdb,blob-db";
            storage = <&blobdb_vol>;
            automount;
    };

  The node is a device. With "automount" its init mounts the store before
  main(), and device_is_ready() reports whether that worked. Without it, the
  first blob_db call mounts the store. "zephyr,deferred-init" postpones
  device init until the application calls device_init(), for an
  application-provisioned UBI key (CONFIG_BLOB_DB_UBI_KEY_APP) that does not
  exist yet at boot.

compatible: "kvdb,blob-db"

include: base.yaml

properties:
  storage:
    type: phandle
    required: true
    description: |
      The UBI volume node (UBI backend) or fixed partition node (flash_area
      backend) the store lives on.

  automount:
    type: boolean
    description: |
      Mount the store during device init, before main(). Without it the
      store is mounted by the first blob_db call that needs it.

  no-format:
    type: boolean
    description: |
      Never format a store whose master sectors are both unreadable: mount
      fails with -EIO instead, and the caller decides with blob_db_format().
      Sets the default of CONFIG_BLOB_DB_AUTOFORMAT_ON_CORRUPT to n. A
      virgin (erased) partition is always formatted.
```

## lib/Kconfig
```kconfig
# Copyright (c) 2021 Legrand North America, LLC.
# SPDX-License-Identifier: Apache-2.0

menu "Custom libraries"

rsource "custom/Kconfig"
rsource "blob_db/Kconfig"
rsource "rootreg/Kconfig"
rsource "containers/Kconfig"
rsource "kvdb/Kconfig"
rsource "blobfs/Kconfig"

endmenu
```

## lib/kvdb/Kconfig
```kconfig
# Copyright (c) 2026
# SPDX-License-Identifier: Apache-2.0

config BLOBDB_KVDB
	bool "kvdb (L3)"
	depends on BLOB_DB
	select BLOB_ROOTREG
	help
	  kvdb — string key -> value interface over any Map container. Turns
	  NUL-terminated string keys into the byte-slice keys a Map container
	  speaks; the backing container is chosen at create time and persisted.
	  See doc/layers/l3_interfaces.md.

if BLOBDB_KVDB

choice
	prompt "kvdb default backend"
	default KVDB_DEFAULT_BACKEND_HASH
	help
	  Backend built for an instance opened with KVDB_BACKEND_DEFAULT (a NULL
	  or unset config). A caller may still request a different backend
	  explicitly, provided that container is also enabled.

config KVDB_DEFAULT_BACKEND_HASH
	bool "kvhash (O(1) hash buckets)"
	select BLOB_CONTAINER_KVHASH

endchoice

module = BLOBDB_KVDB
module-str = BLOBDB_KVDB
source "subsys/logging/Kconfig.template.log_config"

endif # BLOBDB_KVDB
```

## lib/rootreg/Kconfig
```kconfig
# Copyright (c) 2026
# SPDX-License-Identifier: Apache-2.0

config BLOB_ROOTREG
	bool "Root registry (L1.5)"
	depends on BLOB_DB
	help
	  Enable the root registry: a tiny, always-simple map of compile-time
	  keys (ROOTREG_KEY) to structure-root ids, owning id = 1 when enabled.
	  Every mutation is a single atomic blob_db_update — no intent, no
	  recovery machinery. See doc/layers/l1_root_registry.md.

if BLOB_ROOTREG

config ROOTREG_MAX_ROOTS
	int "Max registered roots"
	default 8
	range 1 1000
	help
	  Upper bound on registered structure roots. A BUILD_ASSERT keeps
	  8 + 16 * ROOTREG_MAX_ROOTS within BLOB_DB_MAX_PAYLOAD_LEN.

module = ROOTREG
module-str = ROOTREG
source "subsys/logging/Kconfig.template.log_config"

endif # BLOB_ROOTREG
```

## tests/app_cbor_persondb/testcase.yaml
```yaml
common:
  tags: [storage, cbor, app_cbor_persondb]
  platform_allow: native_sim
tests:
  app.cbor_persondb.superblock: {}
```

## tests/lib/containers/logring/testcase.yaml
```yaml
common:
  tags: storage blob_db containers logring
  platform_allow: native_sim
tests:
  lib.containers.logring: {}
```
