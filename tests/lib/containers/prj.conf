## CMakeLists.txt
```
# Copyright (c) 2026
# SPDX-License-Identifier: Apache-2.0

cmake_minimum_required(VERSION 3.20.0)
find_package(Zephyr REQUIRED HINTS $ENV{ZEPHYR_BASE})
project(containers_test)

# The container providers are built from lib/containers by the module CMake
# when their Kconfigs are enabled; we only add the test itself.
target_sources(app PRIVATE src/main.c src/spill.c src/spill_crash.c src/detach.c)
```

## prj.conf
```kconfig
CONFIG_ZTEST=y

CONFIG_BLOB_DB=y
# Lets the suite assert that read-only ops (count) issue no writes.
CONFIG_BLOB_DB_IOSTATS=y

# Providers under test. The contract suite runs against every one that is
# built in, so enabling kvlist/kvtree here is all it takes to cover them.
CONFIG_BLOB_CONTAINER_KVHASH=y
# Set shape: the set_contract suite runs over every set_ops built in.
CONFIG_BLOB_CONTAINER_SET_OVER_MAP=y

# No kvdb, no rootreg: L2 is tested without its L3 consumer, which is the
# point of having a shape header at all.

# blob_db compaction nests two 4 KB scratch buffers under a 4 KB bucket buffer.
CONFIG_MAIN_STACK_SIZE=32768
CONFIG_ZTEST_STACK_SIZE=32768
CONFIG_LOG=y

# kvhash_spill forces fingerprint collisions.
CONFIG_BLOB_CONTAINER_KVHASH_TEST_HOOKS=y
```

## boards/native_sim.conf
```kconfig
# UBI static PEB pool. blob_db defaults to the UBI backend, and UBI's static
# memory backend sizes its slab pool at compile time: this suite's 8 MB
# partition in the simulator's default 4 KB erase blocks is 2048 PEBs, less
# CONFIG_UBI_DEV_HDR_NR_OF_RES_PEBS (2). Without this the default of 14 builds
# cleanly and then fails to attach the device at runtime.
CONFIG_UBI_MAX_NR_OF_DATA_PEBS=2046
```

## src/detach.c
```c
/*
 * Copyright (c) 2026
 * SPDX-License-Identifier: Apache-2.0
 *
 * kvhash detach-on-update (draft,
 * doc/proposals/2026-11-07-kvhash-detach-on-update.md).
 *
 * What the policy promises, and what these tests pin:
 *
 *   - an insert is placed exactly as without it (inline under the default
 *     thresholds), so a key written once costs what it did before;
 *   - the first set that replaces a value moves it into a blob of its own;
 *   - every later set of that key is ONE flash write, whatever the length;
 *   - reads, short buffers and the walk report the true length;
 *   - it is a write policy: off again, the next set re-inlines and releases
 *     the blob; a map created with it off (v3) is never detached;
 *   - del, destroy and remount neither leak nor lose a detached value.
 *
 * Placement is read off blob_db_count(), as in spill.c. Flash writes are
 * counted through the power-cut hook: arm it far away, run the operation,
 * and see how far it moved.
 */

#include <errno.h>
#include <stdio.h>
#include <string.h>

#include <zephyr/ztest.h>

#include <app/lib/blob_db.h>
#include <app/lib/containers/shape_map.h>
#include <app/lib/containers/kvhash.h>

#define NEVER  32767u
#define FAR    100000

static const struct map_ops *ops = &kvhash_map_ops;

/* What every other suite runs under. */
#define DETACH_DEFAULT IS_ENABLED(CONFIG_BLOB_CONTAINER_KVHASH_DETACH_ON_UPDATE)
#if defined(CONFIG_BLOB_CONTAINER_KVHASH_DETACH_MIN_LEN)
#define DETACH_MIN_DEFAULT CONFIG_BLOB_CONTAINER_KVHASH_DETACH_MIN_LEN
#else
#define DETACH_MIN_DEFAULT 0
#endif

static void detach_before(void *fixture)
{
	ARG_UNUSED(fixture);
	blob_db_unmount();
	zassert_ok(blob_db_mount());
	zassert_ok(blob_db_format());
	kvhash_set_inline_max(NEVER, NEVER);
	kvhash_set_detach_on_update(true);
	kvhash_set_detach_min_len(0);
	kvhash_test_cut_after = -1;
	kvhash_test_cut_fired = false;
}

static void detach_after(void *fixture)
{
	ARG_UNUSED(fixture);
	kvhash_set_inline_max(NEVER, NEVER);
	kvhash_set_detach_on_update(DETACH_DEFAULT);
	kvhash_set_detach_min_len(DETACH_MIN_DEFAULT);
	kvhash_test_cut_after = -1;
	blob_db_unmount();
}

ZTEST_SUITE(kvhash_detach, NULL, NULL, detach_before, detach_after, NULL);

static uint64_t new_map(size_t expected)
{
	struct map_config cfg = { .expected_entries = expected };
	uint64_t root = blob_db_alloc_id();

	zassert_not_equal(root, 0);
	zassert_ok(ops->create(root, &cfg));
	return root;
}

static uint8_t dir_version(uint64_t root)
{
	uint8_t dir[CONFIG_BLOB_DB_MAX_PAYLOAD_LEN];
	size_t dlen = 0;

	zassert_ok(blob_db_get(root, dir, sizeof(dir), &dlen));
	return dir[6];
}

static void fill(uint8_t *v, size_t len, uint8_t tag)
{
	for (size_t i = 0; i < len; i++) {
		v[i] = (uint8_t)(tag + 3 * i);
	}
}

/* Set, and report how many flash writes kvhash issued for it. */
static int set_counting(uint64_t root, const char *k, const void *v, size_t vl,
			int *writes)
{
	kvhash_test_cut_after = FAR;
	int rc = ops->set(root, k, strlen(k), v, vl);

	*writes = FAR - kvhash_test_cut_after;
	kvhash_test_cut_after = -1;
	return rc;
}

static void expect(uint64_t root, const char *k, const void *v, size_t vl)
{
	uint8_t got[128];
	size_t len = 0;

	zassert_ok(ops->get(root, k, strlen(k), got, sizeof(got), &len), "get %s", k);
	zassert_equal(len, vl, "%s: length %zu, want %zu", k, len, vl);
	zassert_mem_equal(got, v, vl, "%s: value", k);
}

ZTEST(kvhash_detach, test_map_version_follows_the_policy_at_create)
{
	zassert_equal(dir_version(new_map(8)), 4, "detaching on: v4");
	kvhash_set_detach_on_update(false);
	zassert_equal(dir_version(new_map(8)), 3, "detaching off: v3, as before");
}

/*
 * The life of one key: inline at insert, detached at the first update, and
 * one write per update after that, through length changes in both directions
 * and down to an empty value.
 */
ZTEST(kvhash_detach, test_insert_inline_update_detached_then_one_write_each)
{
	uint64_t root = new_map(8);
	uint8_t v[100];
	int w;

	/* A neighbour in the same map, so a bucket rewrite would be visible. */
	fill(v, 40, 0x10);
	zassert_ok(ops->set(root, "neighbour", 9, v, 40));

	size_t base = blob_db_count();

	fill(v, 60, 0x20);
	zassert_ok(set_counting(root, "key", v, 60, &w));
	zassert_true(blob_db_count() <= base + 1, "insert spilled (only a fresh bucket allowed)");
	base = blob_db_count();
	expect(root, "key", v, 60);

	fill(v, 64, 0x30);
	zassert_ok(set_counting(root, "key", v, 64, &w));
	zassert_equal(blob_db_count(), base + 1, "first update did not detach");
	zassert_equal(w, 2, "first update: value blob + bucket, got %d writes", w);
	expect(root, "key", v, 64);

	static const size_t lens[] = { 64, 80, 7, 99, 0, 33 };

	for (size_t i = 0; i < ARRAY_SIZE(lens); i++) {
		fill(v, lens[i], (uint8_t)(0x40 + i));
		zassert_ok(set_counting(root, "key", v, lens[i], &w));
		zassert_equal(w, 1, "update to %zu B: %d writes, want 1", lens[i], w);
		zassert_equal(blob_db_count(), base + 1, "update to %zu B moved data", lens[i]);
		expect(root, "key", v, lens[i]);
	}

	fill(v, 40, 0x10);
	expect(root, "neighbour", v, 40);
}

ZTEST(kvhash_detach, test_short_buffer_reports_true_length)
{
	uint64_t root = new_map(8);
	uint8_t v[48], got[16];
	size_t len = 0;

	fill(v, sizeof(v), 1);
	zassert_ok(ops->set(root, "k", 1, v, 10));
	zassert_ok(ops->set(root, "k", 1, v, sizeof(v))); /* detached */

	zassert_equal(ops->get(root, "k", 1, got, sizeof(got), &len), -ENOMEM);
	zassert_equal(len, sizeof(v), "length %zu", len);

	uint8_t k[8];
	size_t kl = 0, vl = 0;

	zassert_equal(ops->next(root, NULL, 0, k, sizeof(k), &kl, got, sizeof(got), &vl),
		      -ENOMEM);
	zassert_equal(vl, sizeof(v), "walk length %zu", vl);

	uint8_t big[64];

	zassert_ok(ops->next(root, NULL, 0, k, sizeof(k), &kl, big, sizeof(big), &vl));
	zassert_equal(kl, 1);
	zassert_equal(vl, sizeof(v));
	zassert_mem_equal(big, v, sizeof(v));
}

/*
 * Mixed population: half the keys updated (detached), half not (inline).
 * get, walk and count agree; turning the policy off moves nothing until a key
 * is set again, and then releases its blob; destroy leaves nothing behind.
 */
/* Value lengths small enough for the suite's 256 B payload cap. */
#define VL0(i) (8 + (i) % 6)
#define VL1(i) (12 + (i) % 5)

ZTEST(kvhash_detach, test_policy_off_reinlines_on_rewrite_and_nothing_leaks)
{
	enum { N = 24 };
	size_t baseline = blob_db_count();
	struct map_config cfg = { .expected_entries = N, .typical_entry_bytes = 32 };
	uint64_t root = blob_db_alloc_id();
	uint8_t v[64];
	char k[16];
	int gen[N] = { 0 };

	zassert_ok(ops->create(root, &cfg));

	for (int i = 0; i < N; i++) {
		snprintf(k, sizeof(k), "dev-%02d", i);
		fill(v, VL0(i), (uint8_t)i);
		zassert_ok(ops->set(root, k, strlen(k), v, VL0(i)));
	}
	size_t inline_blobs = blob_db_count();

	for (int i = 0; i < N; i += 2) {
		snprintf(k, sizeof(k), "dev-%02d", i);
		gen[i] = 1;
		fill(v, VL1(i), (uint8_t)(i + 100));
		zassert_ok(ops->set(root, k, strlen(k), v, VL1(i)));
	}
	zassert_equal(blob_db_count(), inline_blobs + N / 2, "one blob per updated key");

	size_t n = 0;

	zassert_ok(ops->count(root, &n));
	zassert_equal(n, N);

	/* The walk sees every key with its current value. */
	uint8_t cur[16], kk[16], vv[64];
	size_t clen = 0, kl, vl, walked = 0;

	while (ops->next(root, cur, clen, kk, sizeof(kk), &kl, vv, sizeof(vv), &vl) == 0) {
		int i = (kk[4] - '0') * 10 + (kk[5] - '0');

		fill(v, gen[i] ? VL1(i) : VL0(i), (uint8_t)(gen[i] ? i + 100 : i));
		zassert_equal(vl, gen[i] ? VL1(i) : VL0(i), "walk length of %d", i);
		zassert_mem_equal(vv, v, vl, "walk value of %d", i);
		memcpy(cur, kk, kl);
		clen = kl;
		walked++;
	}
	zassert_equal(walked, N);

	/* Off: nothing moves until a key is set; then its blob goes. */
	kvhash_set_detach_on_update(false);
	zassert_equal(blob_db_count(), inline_blobs + N / 2);
	for (int i = 0; i < N; i += 2) {
		snprintf(k, sizeof(k), "dev-%02d", i);
		fill(v, VL1(i), (uint8_t)(i + 100));
		expect(root, k, v, VL1(i));
		fill(v, 9, (uint8_t)(i + 50));
		zassert_ok(ops->set(root, k, strlen(k), v, 9));
		expect(root, k, v, 9);
	}
	zassert_equal(blob_db_count(), inline_blobs, "re-inlined values not released");

	/* On again, detach some, delete some, then destroy: no leak. */
	kvhash_set_detach_on_update(true);
	for (int i = 0; i < N; i += 3) {
		snprintf(k, sizeof(k), "dev-%02d", i);
		zassert_ok(ops->set(root, k, strlen(k), v, 14));
	}
	for (int i = 0; i < N; i += 6) {
		snprintf(k, sizeof(k), "dev-%02d", i);
		zassert_ok(ops->del(root, k, strlen(k)));
	}
	zassert_ok(ops->destroy(root));
	zassert_equal(blob_db_count(), baseline, "%zu blob(s) leaked",
		      blob_db_count() - baseline);
}

ZTEST(kvhash_detach, test_v3_map_is_never_detached)
{
	kvhash_set_detach_on_update(false);
	uint64_t root = new_map(8);

	kvhash_set_detach_on_update(true);

	uint8_t v[40];
	size_t base;

	fill(v, sizeof(v), 7);
	zassert_ok(ops->set(root, "k", 1, v, sizeof(v)));
	base = blob_db_count();
	for (int i = 0; i < 4; i++) {
		v[0] = (uint8_t)i;
		zassert_ok(ops->set(root, "k", 1, v, sizeof(v)));
		zassert_equal(blob_db_count(), base, "a v3 map detached a value");
		expect(root, "k", v, sizeof(v));
	}
	zassert_equal(dir_version(root), 3);
}

ZTEST(kvhash_detach, test_detached_values_survive_remount)
{
	uint64_t root = new_map(8);
	uint8_t v[50];

	fill(v, 10, 1);
	zassert_ok(ops->set(root, "a", 1, v, 10));
	fill(v, 50, 2);
	zassert_ok(ops->set(root, "a", 1, v, 50));
	fill(v, 11, 3);
	zassert_ok(ops->set(root, "a", 1, v, 11));

	zassert_ok(blob_db_unmount());
	kvhash_set_detach_on_update(false); /* a reader needs no policy */
	zassert_ok(blob_db_mount());
	expect(root, "a", v, 11);
}

/* A value spilled by the thresholds (it records its length) becomes detached
 * at its next length-changing set, and is one write per set from then on. */
ZTEST(kvhash_detach, test_threshold_spilled_value_converts)
{
	uint64_t root = new_map(8);
	uint8_t v[64];
	size_t base;
	int w;

	kvhash_set_inline_max(NEVER, 16);
	fill(v, 32, 1);
	zassert_ok(ops->set(root, "s", 1, v, 32)); /* insert: spilled, sized */
	base = blob_db_count();

	fill(v, 32, 2);
	zassert_ok(set_counting(root, "s", v, 32, &w));
	zassert_equal(w, 1, "same-length spilled update is one write");

	fill(v, 40, 3);
	zassert_ok(set_counting(root, "s", v, 40, &w));
	zassert_equal(blob_db_count(), base, "the old value blob was not released");
	expect(root, "s", v, 40);

	fill(v, 20, 4);
	zassert_ok(set_counting(root, "s", v, 20, &w));
	zassert_equal(w, 1, "detached now: one write at a new length, got %d", w);
	expect(root, "s", v, 20);
}

/* A short update stays inline; once a value is detached, a short one does
 * not bring it back. */
ZTEST(kvhash_detach, test_short_updates_stay_inline)
{
	uint64_t root = new_map(8);
	uint8_t v[40];
	size_t base;
	int w;

	kvhash_set_detach_min_len(16);
	fill(v, 8, 1);
	zassert_ok(ops->set(root, "k", 1, v, 8));
	base = blob_db_count();

	fill(v, 15, 2);
	zassert_ok(ops->set(root, "k", 1, v, 15));
	zassert_equal(blob_db_count(), base, "a 15 B update detached at min 16");
	expect(root, "k", v, 15);

	fill(v, 16, 3);
	zassert_ok(ops->set(root, "k", 1, v, 16));
	zassert_equal(blob_db_count(), base + 1, "a 16 B update stayed inline");

	fill(v, 2, 4);
	zassert_ok(set_counting(root, "k", v, 2, &w));
	zassert_equal(w, 1, "a detached value stays detached when it shrinks");
	zassert_equal(blob_db_count(), base + 1);
	expect(root, "k", v, 2);
}
```

## src/set.c
```c
/*
 * Copyright (c) 2026
 * SPDX-License-Identifier: Apache-2.0
 *
 * ztest suite for the L2 Set shape (set_ops).
 *
 * Like map_contract, written against the shape: every test in `set_contract`
 * loops over `set_providers[]`, so the native kvhash set (proposal step 3)
 * is covered by adding one row. `set_over_map` holds what is specific to the
 * adapter: how it treats a root that is a map with values in it.
 *
 * See doc/proposals/2026-10-31-set-shape.md §6.
 */

#include <errno.h>
#include <stdio.h>
#include <string.h>

#include <zephyr/ztest.h>

#include <app/lib/blob_db.h>
#include <app/lib/blob_db_iostats.h>
#include <app/lib/containers/shape_set.h>
#include <app/lib/containers/set_over_map.h>
#include <app/lib/containers/kvhash.h>

struct set_provider {
	const char *name;
	const struct set_ops *ops;
};

static const struct set_provider set_providers[] = {
	{ "set_over_kvhash", &set_over_kvhash_ops },
};

#define FOR_EACH_SET(p)                                                        \
	for (const struct set_provider *p = set_providers;                     \
	     p < set_providers + ARRAY_SIZE(set_providers); p++)

static void set_before(void *fixture)
{
	ARG_UNUSED(fixture);
	blob_db_unmount();
	zassert_ok(blob_db_mount());
	zassert_ok(blob_db_format());
}

static void set_after(void *fixture)
{
	ARG_UNUSED(fixture);
	blob_db_unmount();
}

ZTEST_SUITE(set_contract, NULL, NULL, set_before, set_after, NULL);
ZTEST_SUITE(set_over_map, NULL, NULL, set_before, set_after, NULL);

static uint64_t fresh_set(const struct set_provider *p, size_t expected)
{
	struct set_config cfg = { .expected_members = expected };
	uint64_t root = blob_db_alloc_id();

	zassert_not_equal(root, 0, "%s: alloc_id failed", p->name);
	zassert_ok(p->ops->create(root, &cfg), "%s: create", p->name);
	return root;
}

static size_t members(const struct set_provider *p, uint64_t root)
{
	size_t n = SIZE_MAX;

	zassert_ok(p->ops->count(root, &n), "%s: count", p->name);
	return n;
}

/* Members m000..m999: four bytes. @p i stays below 1000. */
static void member_name(char *buf, size_t sz, int i)
{
	snprintf(buf, sz, "m%03u", (unsigned int)i % 1000u);
}

/* ---- the contract ------------------------------------------------- */

ZTEST(set_contract, test_op_vector_is_complete)
{
	FOR_EACH_SET(p) {
		zassert_not_null(p->ops->create, "%s", p->name);
		zassert_not_null(p->ops->stat, "%s", p->name);
		zassert_not_null(p->ops->has, "%s", p->name);
		zassert_not_null(p->ops->add, "%s", p->name);
		zassert_not_null(p->ops->del, "%s", p->name);
		zassert_not_null(p->ops->next, "%s", p->name);
		zassert_not_null(p->ops->count, "%s", p->name);
		zassert_not_null(p->ops->destroy, "%s", p->name);
	}
}

ZTEST(set_contract, test_create_yields_an_empty_set)
{
	FOR_EACH_SET(p) {
		uint64_t root = fresh_set(p, 8);
		char k[8];
		size_t kl = 0;

		zassert_equal(p->ops->has(root, "k", 1), -ENOENT, "%s", p->name);
		zassert_equal(p->ops->del(root, "k", 1), -ENOENT, "%s", p->name);
		zassert_equal(p->ops->next(root, NULL, 0, k, sizeof(k), &kl),
			      -ENODATA, "%s", p->name);
		zassert_equal(members(p, root), 0, "%s", p->name);
	}
}

ZTEST(set_contract, test_create_accepts_null_config_and_stat_reports)
{
	FOR_EACH_SET(p) {
		uint64_t root = blob_db_alloc_id();
		struct set_info info;

		zassert_ok(p->ops->create(root, NULL), "%s", p->name);
		zassert_ok(p->ops->stat(root, &info), "%s", p->name);
		zassert_true(info.depth >= 1, "%s", p->name);
		zassert_true(info.buckets >= 1, "%s", p->name);
		zassert_true(info.key_bytes_limit > 0, "%s", p->name);
		zassert_equal(p->ops->stat(root, NULL), -EINVAL, "%s", p->name);
		zassert_ok(p->ops->add(root, "x", 1), "%s", p->name);
	}
}

ZTEST(set_contract, test_add_has_del_roundtrip)
{
	FOR_EACH_SET(p) {
		uint64_t root = fresh_set(p, 8);

		zassert_ok(p->ops->add(root, "door", 4), "%s", p->name);
		zassert_ok(p->ops->has(root, "door", 4), "%s", p->name);
		zassert_equal(p->ops->has(root, "doo", 3), -ENOENT,
			      "%s: a prefix is not a member", p->name);
		zassert_equal(p->ops->has(root, "doors", 5), -ENOENT,
			      "%s: an extension is not a member", p->name);
		zassert_ok(p->ops->del(root, "door", 4), "%s", p->name);
		zassert_equal(p->ops->has(root, "door", 4), -ENOENT, "%s", p->name);
		zassert_equal(p->ops->del(root, "door", 4), -ENOENT, "%s", p->name);
	}
}

/* No duplicates: the second add is -EEXIST and the set holds one member. */
ZTEST(set_contract, test_repeated_add_is_eexist)
{
	FOR_EACH_SET(p) {
		uint64_t root = fresh_set(p, 8);

		zassert_ok(p->ops->add(root, "lift", 4), "%s", p->name);
		zassert_equal(p->ops->add(root, "lift", 4), -EEXIST, "%s", p->name);
		zassert_equal(p->ops->add(root, "lift", 4), -EEXIST, "%s", p->name);
		zassert_equal(members(p, root), 1, "%s", p->name);
		zassert_ok(p->ops->del(root, "lift", 4), "%s", p->name);
		zassert_ok(p->ops->add(root, "lift", 4),
			   "%s: a removed member can be added again", p->name);
	}
}

/* The advantage the shape promises: a re-add issues no write at all. */
ZTEST(set_contract, test_repeated_add_writes_nothing)
{
	FOR_EACH_SET(p) {
		uint64_t root = fresh_set(p, 8);
		struct blob_db_iostats io;
		size_t blobs;

		zassert_ok(p->ops->add(root, "park", 4), "%s", p->name);
		blobs = blob_db_count();
		blob_db_iostats_reset();

		zassert_equal(p->ops->add(root, "park", 4), -EEXIST, "%s", p->name);

		blob_db_iostats_get(&io);
		zassert_equal(io.writes, 0, "%s: re-add issued %u write(s)",
			      p->name, io.writes);
		zassert_equal(io.erases, 0, "%s", p->name);
		zassert_equal(blob_db_count(), blobs, "%s", p->name);
	}
}

ZTEST(set_contract, test_rejects_null_and_empty_keys)
{
	FOR_EACH_SET(p) {
		uint64_t root = fresh_set(p, 8);

		zassert_equal(p->ops->has(root, NULL, 1), -EINVAL, "%s", p->name);
		zassert_equal(p->ops->has(root, "k", 0), -EINVAL, "%s", p->name);
		zassert_equal(p->ops->add(root, NULL, 1), -EINVAL, "%s", p->name);
		zassert_equal(p->ops->add(root, "k", 0), -EINVAL, "%s", p->name);
		zassert_equal(p->ops->del(root, NULL, 1), -EINVAL, "%s", p->name);
		zassert_equal(p->ops->del(root, "k", 0), -EINVAL, "%s", p->name);
		zassert_equal(members(p, root), 0, "%s", p->name);
	}
}

/* Members are byte strings: NULs, high bytes, and lengths either side of
 * 127/128 (the native provider's header-form boundary, §4.2). */
ZTEST(set_contract, test_binary_and_boundary_keys)
{
	static uint8_t k127[127], k128[128];
	const uint8_t nul[3] = { 'a', 0x00, 'b' };
	const uint8_t nul2[3] = { 'a', 0x00, 'c' };
	const uint8_t one = 0xff;

	memset(k127, 0xa5, sizeof(k127));
	memset(k128, 0xa5, sizeof(k128));

	FOR_EACH_SET(p) {
		uint64_t root = fresh_set(p, 8);

		zassert_ok(p->ops->add(root, nul, sizeof(nul)), "%s", p->name);
		zassert_equal(p->ops->has(root, nul2, sizeof(nul2)), -ENOENT,
			      "%s: compared past the NUL", p->name);
		zassert_ok(p->ops->add(root, &one, 1), "%s", p->name);
		zassert_ok(p->ops->add(root, k127, sizeof(k127)), "%s", p->name);
		zassert_ok(p->ops->add(root, k128, sizeof(k128)), "%s", p->name);

		zassert_ok(p->ops->has(root, nul, sizeof(nul)), "%s", p->name);
		zassert_ok(p->ops->has(root, &one, 1), "%s", p->name);
		zassert_ok(p->ops->has(root, k127, sizeof(k127)), "%s", p->name);
		zassert_ok(p->ops->has(root, k128, sizeof(k128)), "%s", p->name);
		zassert_equal(members(p, root), 4, "%s", p->name);

		zassert_ok(p->ops->del(root, k127, sizeof(k127)), "%s", p->name);
		zassert_ok(p->ops->has(root, k128, sizeof(k128)),
			   "%s: the 128-byte key went with its 127-byte prefix",
			   p->name);
	}
}

/* The return codes are exact enough to keep a count by: +1 per 0 from add,
 * -1 per 0 from del. The kept figure must agree with count at every step. */
ZTEST(set_contract, test_count_kept_from_return_codes)
{
	const int n = 60;

	FOR_EACH_SET(p) {
		uint64_t root = fresh_set(p, n);
		size_t kept = 0;
		char k[8];

		for (int round = 0; round < 3; round++) {
			for (int i = 0; i < n; i += 1 + round) {
				member_name(k, sizeof(k), i);
				int rc = p->ops->add(root, k, strlen(k));

				zassert_true(rc == 0 || rc == -EEXIST, "%s: %d",
					     p->name, rc);
				kept += (rc == 0);
			}
			for (int i = round; i < n; i += 5) {
				member_name(k, sizeof(k), i);
				int rc = p->ops->del(root, k, strlen(k));

				zassert_true(rc == 0 || rc == -ENOENT, "%s: %d",
					     p->name, rc);
				kept -= (rc == 0);
			}
			zassert_equal(members(p, root), kept,
				      "%s: round %d", p->name, round);
		}
	}
}

/* next: every member exactly once, then -ENODATA. */
ZTEST(set_contract, test_next_visits_every_member_once)
{
	const int n = 40;

	FOR_EACH_SET(p) {
		uint64_t root = fresh_set(p, n);
		bool seen[40] = { false };
		char cur[8], k[8];
		size_t clen = 0, kl = 0;
		int visited = 0, rc;

		for (int i = 0; i < n; i++) {
			member_name(k, sizeof(k), i);
			zassert_ok(p->ops->add(root, k, strlen(k)), "%s", p->name);
		}

		while ((rc = p->ops->next(root, cur, clen, k, sizeof(k), &kl)) == 0) {
			int i;

			zassert_equal(kl, 4, "%s", p->name);
			zassert_equal(sscanf(k, "m%03d", &i), 1, "%s", p->name);
			zassert_true(i >= 0 && i < n, "%s", p->name);
			zassert_false(seen[i], "%s: %.4s twice", p->name, k);
			seen[i] = true;
			visited++;
			memcpy(cur, k, kl);
			clen = kl;
		}
		zassert_equal(rc, -ENODATA, "%s", p->name);
		zassert_equal(visited, n, "%s", p->name);
	}
}

ZTEST(set_contract, test_next_too_small_reports_length)
{
	FOR_EACH_SET(p) {
		uint64_t root = fresh_set(p, 8);
		char k[4];
		size_t kl = 0;

		zassert_ok(p->ops->add(root, "abcdefgh", 8), "%s", p->name);
		zassert_equal(p->ops->next(root, NULL, 0, k, sizeof(k), &kl),
			      -ENOMEM, "%s", p->name);
		zassert_equal(kl, 8, "%s", p->name);
		zassert_equal(p->ops->next(root, NULL, 0, NULL, 0, &kl), -ENOMEM,
			      "%s", p->name);
		zassert_equal(p->ops->next(root, NULL, 1, k, sizeof(k), &kl),
			      -EINVAL, "%s", p->name);
	}
}

/* A deleted cursor still has a successor; mutating mid-walk is allowed. */
ZTEST(set_contract, test_next_from_a_deleted_cursor)
{
	FOR_EACH_SET(p) {
		uint64_t root = fresh_set(p, 16);
		char first[8], k[8];
		size_t fl = 0, kl = 0;
		int rest = 0;

		for (int i = 0; i < 10; i++) {
			member_name(k, sizeof(k), i);
			zassert_ok(p->ops->add(root, k, strlen(k)), "%s", p->name);
		}
		zassert_ok(p->ops->next(root, NULL, 0, first, sizeof(first), &fl));
		zassert_ok(p->ops->del(root, first, fl), "%s", p->name);

		const char *cur = first;
		size_t clen = fl;

		while (p->ops->next(root, cur, clen, k, sizeof(k), &kl) == 0) {
			zassert_false(kl == fl && memcmp(k, first, fl) == 0,
				      "%s: the deleted cursor came back", p->name);
			rest++;
			memcpy(first, k, kl);
			fl = kl;
			cur = first;
			clen = kl;
		}
		zassert_equal(rest, 9, "%s", p->name);
	}
}

ZTEST(set_contract, test_set_survives_remount)
{
	FOR_EACH_SET(p) {
		uint64_t root = fresh_set(p, 8);

		zassert_ok(p->ops->add(root, "persist", 7), "%s", p->name);
		zassert_ok(blob_db_unmount());
		zassert_ok(blob_db_mount());

		zassert_ok(p->ops->has(root, "persist", 7), "%s", p->name);
		zassert_equal(p->ops->add(root, "persist", 7), -EEXIST, "%s", p->name);
		zassert_ok(p->ops->add(root, "after", 5), "%s", p->name);
		zassert_equal(members(p, root), 2, "%s", p->name);
	}
}

ZTEST(set_contract, test_destroy_releases_every_blob)
{
	FOR_EACH_SET(p) {
		size_t baseline = blob_db_count();
		uint64_t root = fresh_set(p, 4);
		char k[8];

		for (int i = 0; i < 16; i++) {
			member_name(k, sizeof(k), i);
			zassert_ok(p->ops->add(root, k, strlen(k)), "%s", p->name);
		}
		zassert_ok(p->ops->destroy(root), "%s", p->name);
		zassert_equal(blob_db_count(), baseline,
			      "%s: destroy left blobs behind", p->name);

		zassert_equal(p->ops->has(root, "m000", 4), -ENOENT, "%s", p->name);
		zassert_equal(p->ops->add(root, "m000", 4), -ENOENT, "%s", p->name);
		zassert_equal(p->ops->destroy(root), -ENOENT, "%s", p->name);
	}
}

/* ---- the adapter -------------------------------------------------- */

/* A root that holds a map with a value is not an adapter set: membership
 * questions about that key are -EIO, never a silent yes. */
ZTEST(set_over_map, test_a_value_is_not_a_member)
{
	uint64_t root = blob_db_alloc_id();
	char k[16];
	size_t kl = 0;

	zassert_ok(kvhash_map_ops.create(root, NULL));
	zassert_ok(kvhash_map_ops.set(root, "valued", 6, "v", 1));

	zassert_equal(set_over_kvhash_ops.has(root, "valued", 6), -EIO);
	zassert_equal(set_over_kvhash_ops.add(root, "valued", 6), -EIO);
	zassert_equal(set_over_kvhash_ops.next(root, NULL, 0, k, sizeof(k), &kl),
		      -EIO);
}

/* An adapter set is a map with empty values, readable as one. */
ZTEST(set_over_map, test_members_are_empty_map_values)
{
	uint64_t root = blob_db_alloc_id();
	size_t vl = 99;

	zassert_ok(set_over_kvhash_ops.create(root, NULL));
	zassert_ok(set_over_kvhash_ops.add(root, "m", 1));
	zassert_ok(kvhash_map_ops.get(root, "m", 1, NULL, 0, &vl));
	zassert_equal(vl, 0);
}

/* set_config reaches the map as a population: a declared size that no map
 * could honour is refused by the set too, and nothing is written. */
ZTEST(set_over_map, test_config_is_forwarded)
{
	struct set_config bad = { .max_key_bytes = 1u << 20 };
	struct set_config ok = { .expected_members = 2000, .typical_key_bytes = 16 };
	struct set_info info;
	size_t blobs = blob_db_count();
	uint64_t root = blob_db_alloc_id();

	zassert_equal(set_over_kvhash_ops.create(root, &bad), -EINVAL);
	zassert_equal(blob_db_count(), blobs);

	zassert_ok(set_over_kvhash_ops.create(root, &ok));
	zassert_ok(set_over_kvhash_ops.stat(root, &info));
	zassert_true(info.buckets > 8, "the population was not forwarded: %u buckets",
		     info.buckets);
}
```

## src/spill.c
```c
/*
 * Copyright (c) 2026
 * SPDX-License-Identifier: Apache-2.0
 *
 * kvhash spilling (doc/proposals/2026-10-09-kvhash-spill.md).
 *
 * The requirement these tests exist for: the inline thresholds are a write
 * policy, not a format. Changing them must never make a stored entry
 * unreadable, never change what a walk returns or in what order, and must
 * move an entry to the new placement only when its key is next set.
 *
 * Placement is not observable through map_ops, so it is read off
 * blob_db_count(): a spilled key or value is one blob of its own.
 */

#include <errno.h>
#include <stdio.h>
#include <string.h>

#include <zephyr/ztest.h>

#include <app/lib/blob_db.h>
#include <app/lib/containers/shape_map.h>
#include <app/lib/containers/kvhash.h>

#define NEVER    32767u /* threshold that spills nothing */
#define N_KEYS   16
#define KMAX     160
#define VMAX     64

static const struct map_ops *ops = &kvhash_map_ops;

static void spill_before(void *fixture)
{
	ARG_UNUSED(fixture);
	blob_db_unmount();
	zassert_ok(blob_db_mount());
	zassert_ok(blob_db_format());
	kvhash_set_inline_max(NEVER, NEVER);
	/* These tests pin placement by the thresholds alone; detach-on-update
	 * would move a value on its first rewrite (kvhash_detach covers it). */
	kvhash_set_detach_on_update(false);
	kvhash_test_fp_mask = 0xffffffffu;
}

static void spill_after(void *fixture)
{
	ARG_UNUSED(fixture);
	kvhash_set_inline_max(NEVER, NEVER);
	kvhash_set_detach_on_update(IS_ENABLED(CONFIG_BLOB_CONTAINER_KVHASH_DETACH_ON_UPDATE));
	kvhash_test_fp_mask = 0xffffffffu;
	blob_db_unmount();
}

ZTEST_SUITE(kvhash_spill, NULL, NULL, spill_before, spill_after, NULL);

static uint64_t new_map(size_t expected)
{
	struct map_config cfg = { .expected_entries = expected };
	uint64_t root = blob_db_alloc_id();

	zassert_not_equal(root, 0);
	zassert_ok(ops->create(root, &cfg));
	return root;
}

/*
 * Key i and its value at generation g. Keys and values come in four sizes
 * each, so every threshold below splits the population differently.
 */
static const size_t klens[] = { 4, 12, 24, 40 };
static const size_t vlens[] = { 0, 8, 24, 48 };

static size_t make_key(uint8_t *k, int i)
{
	size_t kl = klens[i % 4];

	memset(k, 'a' + (i % 26), kl);
	snprintf((char *)k, kl, "%02d", i); /* distinct prefix; NUL overwritten */
	k[2 < kl ? 2 : kl - 1] = '-';
	return kl;
}

static size_t make_val(uint8_t *v, int i, int g)
{
	size_t vl = vlens[(i / 4 + g) % 4];

	for (size_t j = 0; j < vl; j++) {
		v[j] = (uint8_t)(i * 13 + g * 7 + j);
	}
	return vl;
}

static void put_all(uint64_t root, int g)
{
	uint8_t k[KMAX], v[VMAX];

	for (int i = 0; i < N_KEYS; i++) {
		size_t kl = make_key(k, i);
		size_t vl = make_val(v, i, g);

		zassert_ok(ops->set(root, k, kl, v, vl), "set %d (gen %d)", i, g);
	}
}

/* Every key reads back its value at gen[i]. */
static void check_all(uint64_t root, const int *gen)
{
	uint8_t k[KMAX], want[VMAX], got[VMAX];
	size_t len;

	for (int i = 0; i < N_KEYS; i++) {
		size_t kl = make_key(k, i);
		size_t vl = make_val(want, i, gen[i]);

		zassert_ok(ops->get(root, k, kl, got, sizeof(got), &len), "get %d", i);
		zassert_equal(len, vl, "key %d: length %zu, want %zu", i, len, vl);
		zassert_mem_equal(got, want, vl, "key %d: value", i);
	}
}

/* The order of a full walk, as key indices; also checks each value. */
struct order {
	size_t n;
	int idx[N_KEYS];
};

static void walk_order(uint64_t root, const int *gen, struct order *o)
{
	uint8_t cur[KMAX], k[KMAX], v[VMAX], want[VMAX], probe[KMAX];
	size_t clen = 0, kl, vl;
	int rc;

	o->n = 0;
	while ((rc = ops->next(root, cur, clen, k, sizeof(k), &kl,
			       v, sizeof(v), &vl)) == 0) {
		int hit = -1;

		for (int i = 0; i < N_KEYS; i++) {
			size_t pl = make_key(probe, i);

			if (pl == kl && memcmp(probe, k, kl) == 0) {
				hit = i;
			}
		}
		zassert_true(hit >= 0, "walk returned a foreign key");
		zassert_true(o->n < N_KEYS, "walk does not end");
		zassert_equal(vl, make_val(want, hit, gen[hit]), "walk value length");
		zassert_mem_equal(v, want, vl, "walk value of key %d", hit);
		o->idx[o->n++] = hit;
		memcpy(cur, k, kl);
		clen = kl;
	}
	zassert_equal(rc, -ENODATA);
	zassert_equal(o->n, N_KEYS, "walk returned %zu keys", o->n);
}

/*
 * The requirement itself. Write under one policy, then move through policies
 * that lower, raise, zero and disable each threshold. After every change,
 * before anything is rewritten, the map must read and walk exactly as before
 * and own exactly the same blobs (nothing migrated). Then half the keys are
 * rewritten under the new policy, and everything must still verify.
 */
ZTEST(kvhash_spill, test_thresholds_change_without_touching_stored_entries)
{
	static const size_t pol[][2] = {
		{ 16, 16 }, { 0, 0 }, { NEVER, NEVER }, { 30, 0 }, { 0, NEVER },
		{ 12, 24 }, { NEVER, 8 }, { 4, NEVER },
	};
	int gen[N_KEYS] = { 0 };
	struct order first, now;
	size_t baseline = blob_db_count();
	uint64_t root = new_map(200);

	kvhash_set_inline_max(pol[0][0], pol[0][1]);
	put_all(root, 0);
	check_all(root, gen);
	walk_order(root, gen, &first);

	for (size_t p = 1; p < ARRAY_SIZE(pol); p++) {
		size_t blobs = blob_db_count();
		size_t n = 0;

		kvhash_set_inline_max(pol[p][0], pol[p][1]);

		check_all(root, gen);
		walk_order(root, gen, &now);
		zassert_mem_equal(now.idx, first.idx, sizeof(first.idx),
				  "policy %zu: walk order changed", p);
		zassert_ok(ops->count(root, &n));
		zassert_equal(n, N_KEYS);
		zassert_equal(blob_db_count(), blobs,
			      "policy %zu: a threshold change moved data", p);

		/* Rewrite every other key under the new policy. */
		uint8_t k[KMAX], v[VMAX];

		for (int i = (int)(p % 2); i < N_KEYS; i += 2) {
			gen[i] = (int)p;
			size_t kl = make_key(k, i);
			size_t vl = make_val(v, i, gen[i]);

			zassert_ok(ops->set(root, k, kl, v, vl));
		}
		check_all(root, gen);
		walk_order(root, gen, &now);
		zassert_mem_equal(now.idx, first.idx, sizeof(first.idx),
				  "policy %zu: walk order changed after rewrite", p);
	}

	/* Back to all-inline and rewrite everything: still correct. Then
	 * destroy -- it releases only what the map references, so any blob a
	 * placement change orphaned would keep the count above its baseline. */
	kvhash_set_inline_max(NEVER, NEVER);
	for (int i = 0; i < N_KEYS; i++) {
		gen[i] = 99;
	}
	put_all(root, 99);
	check_all(root, gen);
	walk_order(root, gen, &now);
	zassert_mem_equal(now.idx, first.idx, sizeof(first.idx));

	zassert_ok(ops->destroy(root));
	zassert_equal(blob_db_count(), baseline,
		      "%zu blob(s) leaked across placement changes",
		      blob_db_count() - baseline);
}

/*
 * Lowering a threshold moves nothing; the next set of that key does. Raising
 * it back moves nothing either, until the key is set again -- and then the
 * blob the spilled value occupied is released.
 */
ZTEST(kvhash_spill, test_placement_follows_the_policy_only_on_rewrite)
{
	uint64_t root = new_map(8);
	uint8_t v[40], got[40];
	size_t len, base;

	memset(v, 0x5a, sizeof(v));
	zassert_ok(ops->set(root, "key", 3, v, sizeof(v)));
	base = blob_db_count();

	kvhash_set_inline_max(NEVER, 16);
	zassert_equal(blob_db_count(), base, "lowering moved data");
	zassert_ok(ops->get(root, "key", 3, got, sizeof(got), &len));
	zassert_equal(len, sizeof(v));

	v[0] = 1;
	zassert_ok(ops->set(root, "key", 3, v, sizeof(v)));
	zassert_equal(blob_db_count(), base + 1, "rewrite did not spill the value");
	zassert_ok(ops->get(root, "key", 3, got, sizeof(got), &len));
	zassert_mem_equal(got, v, sizeof(v));

	kvhash_set_inline_max(NEVER, NEVER);
	zassert_equal(blob_db_count(), base + 1, "raising moved data");
	zassert_ok(ops->get(root, "key", 3, got, sizeof(got), &len));
	zassert_mem_equal(got, v, sizeof(v));

	v[0] = 2;
	zassert_ok(ops->set(root, "key", 3, v, sizeof(v)));
	zassert_equal(blob_db_count(), base, "the spilled value was not released");
	zassert_ok(ops->get(root, "key", 3, got, sizeof(got), &len));
	zassert_mem_equal(got, v, sizeof(v));
}

/*
 * A spilled value rewritten at the same length is one blob update: the
 * bucket is not touched, so nothing is allocated or released. A spilled key
 * keeps its blob through any value change.
 */
ZTEST(kvhash_spill, test_spilled_parts_are_reused_where_they_can_be)
{
	uint64_t root = new_map(8);
	uint8_t v[32], got[32];
	const char *key = "a-key-long-enough-to-spill";
	size_t kl = strlen(key), len, base;

	kvhash_set_inline_max(8, 8);
	memset(v, 1, sizeof(v));
	zassert_ok(ops->set(root, key, kl, v, sizeof(v)));
	base = blob_db_count();

	for (int g = 2; g < 6; g++) {
		memset(v, g, sizeof(v));
		zassert_ok(ops->set(root, key, kl, v, sizeof(v)));
		zassert_equal(blob_db_count(), base, "same-length rewrite allocated");
	}
	zassert_ok(ops->get(root, key, kl, got, sizeof(got), &len));
	zassert_mem_equal(got, v, sizeof(v));

	/* A different length: fresh value blob, old one released, key kept. */
	zassert_ok(ops->set(root, key, kl, v, 20));
	zassert_equal(blob_db_count(), base);
	/* Short enough to go inline: the value blob goes, the key blob stays. */
	zassert_ok(ops->set(root, key, kl, v, 4));
	zassert_equal(blob_db_count(), base - 1);
	zassert_ok(ops->get(root, key, kl, got, sizeof(got), &len));
	zassert_equal(len, 4);
	zassert_mem_equal(got, v, 4);
}

/* get with a short buffer reports the true length of a spilled value. */
ZTEST(kvhash_spill, test_spilled_value_too_small_reports_true_length)
{
	uint64_t root = new_map(8);
	uint8_t v[48], got[8];
	size_t len = 0;

	kvhash_set_inline_max(NEVER, 0);
	memset(v, 7, sizeof(v));
	zassert_ok(ops->set(root, "k", 1, v, sizeof(v)));
	zassert_equal(ops->get(root, "k", 1, got, sizeof(got), &len), -ENOMEM);
	zassert_equal(len, sizeof(v));
	zassert_equal(ops->get(root, "k", 1, NULL, 0, &len), -ENOMEM);
	zassert_equal(len, sizeof(v));

	/* An empty value never spills, whatever the threshold. */
	size_t base = blob_db_count();

	zassert_ok(ops->set(root, "e", 1, NULL, 0));
	zassert_ok(ops->get(root, "e", 1, NULL, 0, &len));
	zassert_equal(len, 0);
	zassert_true(blob_db_count() <= base + 1, "an empty value spilled");
}

/* del releases what the entry spilled, and only that. */
ZTEST(kvhash_spill, test_del_releases_spilled_parts)
{
	uint64_t root = new_map(8);
	uint8_t v[32];
	const char *key = "spilled-key-0123456789";
	size_t kl = strlen(key), base;

	memset(v, 3, sizeof(v));
	zassert_ok(ops->set(root, "keep", 4, v, 4));
	base = blob_db_count();

	kvhash_set_inline_max(4, 4);
	zassert_ok(ops->set(root, key, kl, v, sizeof(v)));

	/* Two spilled parts, plus a bucket if the key landed in a fresh one. */
	size_t with = blob_db_count();

	zassert_true(with == base + 2 || with == base + 3,
		     "key and value should be blobs (%zu new)", with - base);

	zassert_ok(ops->del(root, key, kl));
	zassert_equal(blob_db_count(), with - 2, "del left spilled blobs behind");
	zassert_equal(ops->get(root, key, kl, v, sizeof(v), NULL), -ENOENT);
	zassert_ok(ops->get(root, "keep", 4, v, sizeof(v), NULL));
}

/*
 * kvhash's directory: [u32 magic][u16 n][u8 version][u8 depth][u64 id]*n.
 * A map created by v2 firmware must stay parseable by v2 firmware, so v3
 * code serves it but never writes a flagged entry into it.
 */
ZTEST(kvhash_spill, test_v2_map_is_served_but_never_spilled)
{
	uint64_t root = new_map(8);
	uint8_t dir[CONFIG_BLOB_DB_MAX_PAYLOAD_LEN];
	size_t dlen = 0;

	zassert_ok(blob_db_get(root, dir, sizeof(dir), &dlen));
	zassert_equal(dir[6], 3, "new maps are v3");
	zassert_equal(dir[7], 1, "this test needs a one-level map");
	dir[6] = 2;
	zassert_ok(blob_db_update(root, dir, dlen));

	kvhash_set_inline_max(0, 0);

	uint8_t v[16], got[16];
	size_t len, base = blob_db_count();
	int buckets = 0;

	memset(v, 9, sizeof(v));
	for (int i = 0; i < 6; i++) {
		char k[8];

		snprintf(k, sizeof(k), "v2-%d", i);
		size_t before = blob_db_count();

		zassert_ok(ops->set(root, k, strlen(k), v, sizeof(v)));
		/* At most one new blob: a fresh bucket, never a spilled part. */
		zassert_true(blob_db_count() <= before + 1, "a v2 map spilled");
		buckets += (int)(blob_db_count() - before);
		zassert_ok(ops->get(root, k, strlen(k), got, sizeof(got), &len));
		zassert_mem_equal(got, v, sizeof(v));
	}
	zassert_equal(blob_db_count(), base + buckets);

	/* Still a v2 map afterwards. */
	zassert_ok(blob_db_get(root, dir, sizeof(dir), &dlen));
	zassert_equal(dir[6], 2);
}

/*
 * With every fingerprint forced equal, lookups, deletes and the walk order
 * have to tell spilled keys apart by their bytes -- including keys longer
 * than one compare chunk that differ only in their last byte, and spilled
 * keys sharing a bucket with inline keys of the same length.
 */
ZTEST(kvhash_spill, test_fingerprint_collisions_fall_back_to_bytes)
{
	enum { N = 8, LONG = 150 };
	uint64_t root = new_map(2);
	uint8_t k[LONG], got[8];
	size_t len;

	kvhash_test_fp_mask = 0;

	/* Long keys, identical but for the last byte: spilled. */
	kvhash_set_inline_max(0, NEVER);
	memset(k, 'L', sizeof(k));
	for (int i = 0; i < N; i++) {
		k[LONG - 1] = (uint8_t)('0' + i);
		zassert_ok(ops->set(root, k, LONG, &i, sizeof(i)), "long %d", i);
	}

	/* Short keys of one length, half spilled and half inline. */
	for (int i = 0; i < N; i++) {
		char s[8];

		kvhash_set_inline_max(i % 2 ? 0 : NEVER, NEVER);
		snprintf(s, sizeof(s), "s%05d", i);
		zassert_ok(ops->set(root, s, 6, &i, sizeof(i)), "short %d", i);
	}
	kvhash_set_inline_max(NEVER, NEVER);

	for (int i = 0; i < N; i++) {
		int out = -1;
		char s[8];

		k[LONG - 1] = (uint8_t)('0' + i);
		zassert_ok(ops->get(root, k, LONG, &out, sizeof(out), &len));
		zassert_equal(out, i, "long key %d read another's value", i);

		snprintf(s, sizeof(s), "s%05d", i);
		zassert_ok(ops->get(root, s, 6, &out, sizeof(out), &len));
		zassert_equal(out, i, "short key %d read another's value", i);
	}
	k[LONG - 1] = 'x';
	zassert_equal(ops->get(root, k, LONG, got, sizeof(got), &len), -ENOENT);

	/* Two walks: every key exactly once, in the same order both times. */
	static uint8_t order[2][2 * N][LONG];
	static size_t olen[2][2 * N];

	for (int w = 0; w < 2; w++) {
		uint8_t cur[LONG], ko[LONG];
		size_t clen = 0, kl, vl;
		int n = 0, v, rc;

		while ((rc = ops->next(root, cur, clen, ko, sizeof(ko), &kl,
				       &v, sizeof(v), &vl)) == 0) {
			zassert_true(n < 2 * N, "walk does not end");
			for (int j = 0; j < n; j++) {
				zassert_false(olen[w][j] == kl &&
					      memcmp(order[w][j], ko, kl) == 0,
					      "walk returned a key twice");
			}
			memcpy(order[w][n], ko, kl);
			olen[w][n++] = kl;
			memcpy(cur, ko, kl);
			clen = kl;
		}
		zassert_equal(rc, -ENODATA);
		zassert_equal(n, 2 * N, "walk returned %d of %d keys", n, 2 * N);
	}
	zassert_mem_equal(olen[0], olen[1], sizeof(olen[0]), "walk order unstable");
	zassert_mem_equal(order[0], order[1], sizeof(order[0]), "walk order unstable");

	/* Deleting by bytes removes exactly the named key. */
	k[LONG - 1] = '3';
	zassert_ok(ops->del(root, k, LONG));
	zassert_equal(ops->get(root, k, LONG, got, sizeof(got), &len), -ENOENT);
	k[LONG - 1] = '4';
	zassert_ok(ops->get(root, k, LONG, got, sizeof(got), &len));

	size_t n = 0;

	zassert_ok(ops->count(root, &n));
	zassert_equal(n, 2 * N - 1);
}

/* Spilled parts survive a remount, and destroy of an all-spilled map
 * releases every blob. */
ZTEST(kvhash_spill, test_spilled_map_survives_remount_and_destroys_clean)
{
	int gen[N_KEYS] = { 0 };
	struct order a, b;
	size_t baseline = blob_db_count();
	uint64_t root = new_map(200);

	kvhash_set_inline_max(0, 0);
	put_all(root, 0);
	walk_order(root, gen, &a);

	zassert_ok(blob_db_unmount());
	zassert_ok(blob_db_mount());
	kvhash_set_inline_max(NEVER, NEVER); /* a new build, a new policy */

	check_all(root, gen);
	walk_order(root, gen, &b);
	zassert_mem_equal(a.idx, b.idx, sizeof(a.idx));

	zassert_ok(ops->destroy(root));
	zassert_equal(blob_db_count(), baseline, "destroy left %zu blob(s)",
		      blob_db_count() - baseline);
}
```
